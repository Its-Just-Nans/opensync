## src/lib/nfe/kconfig/Kconfig.libs
```kconfig
menuconfig LIB_NFE_RELEASE_BUILD
    bool "NFE library release mode"
    default y
    depends on MANAGER_FSM
    help
        The NFE library will be built in release mode
```

## src/lib/rts/kconfig/Kconfig.libs
```kconfig
menuconfig LIB_RTS_RELEASE_BUILD
    bool "RTS library release mode"
    default y
    depends on MANAGER_FSM
    help
        The RTS library will be built in release mode
```

## src/lib/we_dpi/kconfig/Kconfig.libs
```kconfig
menuconfig WE_DPI_ENGINE
    bool "WE DPI engine support"
    default y
    depends on MANAGER_FSM
    help
        Enable WE DPI engine support for FSM

    config WE_AGENT_BINARY
        depends on WE_DPI_ENGINE
        bool "Install WE Agent binary"
        default y

        help
            Install the WE Agent binary

    config WE_RELEASE_BUILD
        depends on WE_DPI_ENGINE
        bool "WE DPI library release mode"
        default y
        help
            The WE plugin will be built in release mode
```
